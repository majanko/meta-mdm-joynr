## conf/layer.conf
```bitbake
GCCVERSION = "linaro-4.9"
SDKGCCVERSION = "linaro-4.9"
PREFERRED_VERSION_cmake="3.3.1"
#
# Setting the following variables will enable the use of the Linaro toolchain. If not set
#     you will build using gcc built by Yocto. EXTERNAL_TOOLCHAIN must be set to the path
#     where the linaro toolchain exists and should have subdirectories named lib, bin, etc
#
TCLIBC = "external-linaro-toolchain"
TCMODE = "external-linaro"
BUILD_CFLAGS_append = " -march=native"
TARGET_PREFIX = "sh-arm-linux-gnueabi-"
EXTERNAL_TOOLCHAIN = "/home/majanko/gcc-linaro-4.9-2016.02-x86_64_arm-linux-gnueabi"
# We might have a conf and classes directory, append to BBPATH
BBPATH .= ":${LAYERDIR}"

# We have a recipes directory, add to BBFILES
BBFILES += "${LAYERDIR}/recipes*/*/*.bb ${LAYERDIR}/recipes*/*/*.bbappend"

BBFILE_COLLECTIONS += "meta-mdm-joynr"
BBFILE_PATTERN_meta-mdm-joynr := "^${LAYERDIR}/"
BBFILE_PRIORITY_meta-mdm-joynr = "12"

# do not error out on bbappends for missing recipes (mysql5)
BB_DANGLINGAPPENDS_WARNONLY = "true"

LAYERDEPENDS_meta-mdm-joynr = "toolchain-layer"

CPPFLAGS_append_pn-ncurses-native = " -P"
```
